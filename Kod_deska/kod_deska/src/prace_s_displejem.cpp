#include "prace_s_displejem.h"

const unsigned char epd_bitmap_rsz_1l1 [] PROGMEM = {
	0x00, 0x0f, 0xff, 0xf9, 0xff, 0xff, 0xff, 0xf0, 0x00, 0x7f, 0xff, 0xf9, 0xff, 0xff, 0xff, 0xf0, 
    0x01, 0xff, 0xff, 0xf9, 0xff, 0xff, 0xff, 0xf0, 0x03, 0xff, 0xff, 0xf9, 0xff, 0xff, 0xff, 0xf0, 
    0x07, 0xff, 0xff, 0xf9, 0xff, 0xff, 0xff, 0xf0, 0x0f, 0xff, 0xff, 0xf9, 0xff, 0xff, 0xff, 0xf0, 
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    0xff, 0xff, 0xff, 0xf9, 0xff, 0xff, 0xe0, 0x00, 0xff, 0xff, 0xff, 0xf9, 0xff, 0xfe, 0x00, 0x00
};


void vypis_na_displej(unsigned long aktualni_ms)
{
    static unsigned long minuly_cas_aktualizace_displeje = 0;
    const unsigned long interval_aktualizace_displeje = 1000; 
    if (aktualni_ms - minuly_cas_aktualizace_displeje >= interval_aktualizace_displeje)
    {
        if (tlacitko2_stav)
        {
            displej.clearDisplay();
            displej.setCursor(0, 0);
            switch (strana_menu)
            {
            case 0:
            {
                String s_nadpis_teplota_vlhkost = "Telpota      Vlhkost";
                String s_teplota = String(teplota, 1) + "C "; 
                String s_vlhkost = String(vlhkost, 1) + "%";
                String s_nadpis_pocet_osob = "Pocet osob";
                String s_pocet_osob = String(pocet_osob);
                displej.setFont();
                displej.setTextSize(1);
                displej.setCursor(0, 0);
                displej.println(s_nadpis_teplota_vlhkost);
                displej.setFont(&FreeSansBold9pt7b);
                displej.setCursor(0, 24);
                displej.println(s_teplota);
                displej.setCursor(75, 24);
                displej.println(s_vlhkost);
                displej.setFont();
                displej.setCursor(32, 32);
                displej.println(s_nadpis_pocet_osob);
                displej.setFont(&FreeSansBold9pt7b);
                displej.setCursor(60, 54);
                displej.println(s_pocet_osob);
                break;
            }
            case 1:
            {
                String s_nadpis_tlak = "Tlak";
                String s_tlak = String(tlak, 1) + "hPa";
                String s_nadpis_nadmorska_vyska = "Nadmorska vyska";
                String s_nadmorska_vyska = String(nadmorskavyska) + "m";
                displej.setFont();
                displej.setTextSize(1);
                displej.setCursor(55, 0);
                displej.println(s_nadpis_tlak);
                displej.setFont(&FreeSansBold9pt7b);
                displej.setCursor(30, 24);
                displej.println(s_tlak);
                displej.setFont();
                displej.setTextSize(1);
                displej.setCursor(25, 32);
                displej.println(s_nadpis_nadmorska_vyska);
                displej.setFont(&FreeSansBold9pt7b);
                displej.setCursor(45, 56);
                displej.println(s_nadmorska_vyska);
                break;
            }
            case 2:
            {
                displej.clearDisplay();
                displej.drawBitmap(34, 2, epd_bitmap_rsz_1l1, 128, 64, 0xFFFF);
                displej.display();
                break;
            }
            default:
                break;
            }
        }
        else
        {
            displej.clearDisplay();
        }
        displej.display();
        minuly_cas_aktualizace_displeje = aktualni_ms;
    }
}